## boards/shields/temper/Kconfig.defconfig
```kconfig
if SHIELD_TEMPER_LEFT

config ZMK_KEYBOARD_NAME
    default "temper"

config ZMK_SPLIT_ROLE_CENTRAL
    default y

endif

if SHIELD_TEMPER_LEFT || SHIELD_TEMPER_RIGHT

config ZMK_SPLIT
    default y

endif

CONFIG_ZMK_EXT_POWER=y
CONFIG_ZMK_DISPLAY=y
CONFIG_ZMK_DISPLAY_SHARP_LS011B7DH03=y 
CONFIG_ZMK_DISPLAY_SSD1306_SPI=y
```
